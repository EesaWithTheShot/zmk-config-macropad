## Kconfig
```kconfig
config SSD1322_PATCHED
    bool "Use patched SSD1322 driver (with grayscale + inversion)"
    default y
    depends on DISPLAY && MIPI_DBI

config SSD1322_DEFAULT_GRAYSCALE
    bool "Default SSD1322 to L_8 grayscale pixel format"
    depends on SSD1322_PATCHED

config SSD1322_CONV_BUFFER_LINES
    int "Lines of conversion buffer per SSD1322 instance"
    default 4
    depends on SSD1322_PATCHED
```

## boards/shields/macropad/Kconfig.defconfig
```kconfig
if SHIELD_MACROPAD

config ZMK_KEYBOARD_NAME
    # Max 15 chars
    default "macropad"

endif
```

## config/west.yml
```yaml
manifest:
  remotes:
    - name: zmkfirmware
      url-base: https://github.com/zmkfirmware
    # Additional modules containing boards/shields/custom code can be listed here as well
    # See https://docs.zephyrproject.org/3.2.0/develop/west/manifest.html#projects
    - name: eesawiththeshot
      url-base: https://github.com/EesaWithTheShot
  projects:
    - name: zmk
      remote: eesawiththeshot
      revision: ssd1322fix-zmk
      import: app/west.yml
  self:
    path: config
```

## dts/bindings/display/solomon,ssd1322-ext.yaml
```yaml
# Copyright (c) 2024 Lukasz Hawrylko
# Copyright (c) 2025 MASSDRIVER EI
# SPDX-License-Identifier: Apache-2.0

description: Solomon SSD1322 display controller (extended)

compatible: "solomon,ssd1322-ext"

include: [mipi-dbi-spi-device.yaml, display-controller.yaml]

properties:
  column-offset:
    type: int
    required: true
  row-offset:
    type: int
    default: 0
  start-line:
    type: int
    default: 0
  mux-ratio:
    type: int
    default: 63
  segments-per-pixel:
    type: int
    default: 1
    enum: [1, 2]
  remap-row-first:
    type: boolean
  remap-columns:
    type: boolean
  remap-rows:
    type: boolean
  remap-nibble:
    type: boolean
  remap-com-odd-even-split:
    type: boolean
  remap-com-dual:
    type: boolean
  grayscale-enhancement:
    type: boolean
  inversion-on:
    type: boolean
  oscillator-freq:
    type: int
    default: 0x91
  precharge-voltage:
    type: int
    default: 0x1F
  vcomh-voltage:
    type: int
    default: 0x07
  phase-length:
    type: int
    default: 0xE2
  precharge-period:
    type: int
    default: 0x08
```
